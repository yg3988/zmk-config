## config/boards/arm/hotp4ck_c/Kconfig.board
```kconfig
# Copyright (c) 2020 The ZMK Contributors
# SPDX-License-Identifier: MIT

config BOARD_HOTP4CK_C
	bool "hotp4ck_c"
	depends on SOC_NRF52840_QIAA
```

## config/boards/arm/hotp4ck_c/Kconfig.defconfig
```kconfig
# Copyright (c) 2020 The ZMK Contributors
# SPDX-License-Identifier: MIT

if BOARD_HOTP4CK_C

config ZMK_KEYBOARD_NAME
	default "hotp4ck_c"

if USB

config USB_NRFX
	default y

config USB_DEVICE_STACK
	default y

endif # USB

config BT_CTLR
	default BT

config ZMK_BLE
	default y

config ZMK_USB
	default y

config I2C
	default y

config ZMK_MAX17048
	default y

endif # BOARD_HOTP4CK_C
```
